## app/boards/shields/bdn9/Kconfig.defconfig
```kconfig
# Copyright (c) 2020 The ZMK Contributors
# SPDX-License-Identifier: MIT

if SHIELD_BDN9

config ZMK_KEYBOARD_NAME
    default "BDN9"

endif
```
